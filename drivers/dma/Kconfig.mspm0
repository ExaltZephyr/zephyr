## drivers/dma/Kconfig.mspm0
```kconfig
# Copyright (c) 2024 GARDENA GmbH
#
# SPDX-License-Identifier: Apache-2.0

config DMA_MSPM0
	bool "TI MSMP0 DMA controller driver"
	default y
	depends on DT_HAS_TI_MSPM0_DMA_ENABLED
	help
	  Enable DMA controller driver for TI MSPM0 MCUs
```

## drivers/mspi/Kconfig.stm32_ospi
```kconfig
# STM32 Octo SPI flash driver configuration options

# Copyright (c) 2022 STMicroelectronics
# SPDX-License-Identifier: Apache-2.0

DT_STM32_OCTOSPI_HAS_DMA := $(dt_compat_any_has_prop,$(DT_COMPAT_ST_STM32_OSPI),dmas)

config OSPI_STM32
	bool "STM32 OSPI Controller driver"
	default y
	depends on DT_HAS_ST_STM32_OSPI_CONTROLLER_ENABLED
	select USE_STM32_HAL_OSPI if !SOC_SERIES_STM32H5X
	select USE_STM32_LL_DLYB if (SOC_SERIES_STM32H5X || SOC_SERIES_STM32U5X)
	select USE_STM32_HAL_MDMA if SOC_SERIES_STM32H7X
	select DMA 
	select USE_STM32_HAL_DMA 
	select USE_STM32_HAL_DMA_EX 
	help
	  Enable OSPI driver for STM32 family of processors.
```

## drivers/sdhc/Kconfig.stm32
```kconfig
# Copyright (c) 2025 EXALT Technologies.
# SPDX-License-Identifier: Apache-2.0

source "subsys/logging/Kconfig.template.log_config"

config ST_STM32_SDHC
	bool "STM32 SDMMC driver support"
	depends on DT_HAS_ST_STM32_SDHC_ENABLED
	select USE_STM32_HAL_SD 
	select SDHC_SUPPORTS_NATIVE_MODE
	select USE_STM32_LL_SDMMC
	default y
	help
	  Enable support for SDMMC on STM32 microcontrollers.

config SDHC_STM32_DMA
	bool "STM32 SDHC DMA driver support"
	help
	  Enables support for SDHC DMA mode on STM32 microcontrollers.
```

## dts/bindings/dma/ti,mspm0-dma.yaml
```yaml
# Copyright (c) 2024 EXALT Technologies.
# SPDX-License-Identifier: Apache-2.0

description: TI MSPM0 DMA Controller

compatible: "ti,mspm0-dma"

include: dma-controller.yaml

properties:
  reg:
    required: true

  interrupts:
    required: true

  "#dma-cells":
    const: 2

dma-cells:
  - channel
  - src
```

## dts/bindings/mmc/st,stm32-sdhc.yaml
```yaml
description: stm32 sdmmc disk access

compatible: "st,stm32-sdhc"

bus: sd

include: "st,stm32-sdmmc.yaml"

properties:  
  hw-flow-control:
    type: boolean
    description: Set to enable RTS/CTS flow control at boot time

  wifi-on-gpios:
    description: |
      Power-up/down gpio to control the internal regulators used
      by the WiFi section of Wi-Fi device.
    type: phandle-array
```
